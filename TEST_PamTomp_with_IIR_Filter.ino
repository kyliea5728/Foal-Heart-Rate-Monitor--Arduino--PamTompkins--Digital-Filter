#include <Wire.h> //for I2C
#include <Arduino_LSM6DSOX.h>

#define SAMPLINGRATE 100 //Hz
#define SAMPLINGPERIOD 10 //ms (1/SAMPLINGRATE)
#define ECG_PIN A0
#define REFRACTORY 200 // period to wait before another R-wave is possible (ms)
#define TEST_DATA 500 //size of test data array

// Pan-Tompkins parameters
const int windowSize = 10; // May need tuning -> QRS duration estimated 100ms -> QRS duration(ms)/SAMPLINGPERIOD(ms)
float integratedSignal[windowSize] = {0};
float threshold = 0.5; // Needs to be tuned according to actual QRS amplitude
long lastRPeakTime = 0; //used to store the timestamp of the last detected R-peak. Initially set to 0


const int N = 4; //filter order 

//IIR filter coefficients 
float a[] = {1, -0.173514480931608, -0.509686073269145, 0.00937421452681886, 0.219653983913695};
float b[] = {0.434739348284746, 0, -0.869478696569493, 0, 0.434739348284746};

// Arrays for past samples
float x[N+1] = {0};
float y[N+1] = {0};

const float testData[TEST_DATA] = {2.87783350340218e-137,1.25684138007291e-126,2.01929976923598e-116,1.19351158379274e-106,2.59512331452403e-97,2.07584479010505e-88,6.10853793864176e-80,
6.61279699719503e-72,2.63353214678231e-64,3.85831405896362e-57,2.07951494046179e-50,4.12317751186526e-44,3.00751317294248e-38,8.07027924003171e-33,7.96663837451876e-28,
2.89312477194586e-23,3.8651356637325e-19,1.89962483236415e-15,3.43460226846832e-12,2.28449696170689e-09,5.58997975811805e-07,5.03193941853766e-05,0.00166634948073635,
0.0203002924854919,0.0909795989568949,0.15,0.0909795989568949,0.0203002924854918,0.00166634948073633,5.03193941853772e-05,5.58997975811805e-07,2.28449696170689e-09,
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4.84363784357858e-88,3.60031697827339e-85,2.39472071440611e-82,1.42532551901641e-79,7.59133764597358e-77,3.61799209298572e-74,1.54298596601209e-71,-3.46585823410224e-50
};


int testIndex = 0;


void setup() {
  // put your setup code here, to run once:
   Wire.begin();
    Serial.begin(9600);
    IMU.begin();
    Serial.println(" ");
    Serial.println("Started");
}

void loop() {
  // put your main code here, to run repeatedly:
 unsigned long startTime = millis();

    if (testIndex < TEST_DATA){

      // Get the current ECG sample
        float ECG = 10*testData[testIndex++]; // Increment testIndex for the next loop iteration

        // Apply the IIR filter to the ECG sample
        float filteredECG = filter(ECG);

        // Apply Pan-Tompkins for QRS detection
        if (detectQRS(filteredECG)) {
            float heartRate = calculateHeartRate(millis());
            Serial.println(" ");
            Serial.print("Heart Rate: ");
            Serial.print(heartRate);
            Serial.println(" BPM");
        }
        unsigned long endTime = millis();
        unsigned long elapsedTime = endTime - startTime;

        if (elapsedTime < SAMPLINGPERIOD) { //account for the time that has elapsed during program execution when sampling
            delay(SAMPLINGPERIOD - elapsedTime);
        }

      Serial.print(filteredECG);
      Serial.print("     ");
    }    

}

bool detectQRS(float sample) {
    // Differentiate and square (simplified example)
    static float lastSample = 0;
    float derivative = sample - lastSample;
    lastSample = sample;
    float squared = derivative * derivative;

    // Moving window integration
    static int index = 0;
    integratedSignal[index] = squared;
    index = (index + 1) % windowSize;
    float sum = 0;
    for (int i = 0; i < windowSize; i++) {
        sum += integratedSignal[i];
    }
    float integrated = sum / windowSize;

    // Thresholding for QRS detection
    long currentTime = millis();
    if (integrated > threshold && currentTime - lastRPeakTime > REFRACTORY) { // 200 ms refractory period
        lastRPeakTime = currentTime;
        return true; // QRS detected
    }
    return false;
}

float calculateHeartRate(long rPeakTime) {
    static long lastRPeakTime = 0; //not reinitialized to 0 each time because static

    if (lastRPeakTime == 0) { //if this is the first R peak detected 
        lastRPeakTime = rPeakTime;
        return 0; 
    }
    
    float rrInterval = (rPeakTime - lastRPeakTime) / 1000.0; // Convert milliseconds to seconds
    lastRPeakTime = rPeakTime;
    return 60.0 / rrInterval; // BPM
}


//Function for digital IIR Bandpass filter
float filter(float input) { 
    // Shift past samples
    for (int i = N; i > 0; --i) {
        x[i] = x[i - 1];
        y[i] = y[i - 1];
    }

    // Add new sample
    x[0] = input;

    // Compute the filter output
    float output = b[0] * x[0]; // Initialize with the first term
    for (int i = 1; i <= N; ++i) {
        output += b[i] * x[i]; // Apply b coefficients
        output -= a[i] * y[i]; // Apply a coefficients, skipping a[0] as it's assumed to be 1
    }

    y[0] = output;
    return output;
}

