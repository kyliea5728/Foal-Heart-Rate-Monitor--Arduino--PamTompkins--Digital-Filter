#include <Wire.h> //for I2C
#include <Arduino_LSM6DSOX.h>

#define SAMPLINGRATE 250 //Hz
#define SAMPLINGPERIOD 10 //ms (1/SAMPLINGRATE)
#define ECG_PIN A0
#define REFRACTORY 200 // period to wait before another R-wave is possible (ms)
#define TEST_DATA 1000 //size of test data array

// Pan-Tompkins parameters
const int windowSize = 10; // May need tuning -> QRS duration estimated 100ms -> QRS duration(ms)/SAMPLINGPERIOD(ms)
float integratedSignal[windowSize] = {0};
float threshold = 0.5; // Needs to be tuned according to actual QRS amplitude
long lastRPeakTime = 0; //used to store the timestamp of the last detected R-peak. Initially set to 0

const float testData[TEST_DATA] = {1.25110746174107e-137,5.46398402472367e-127,8.7786906567867e-117,5.18866448123585e-107,1.12820221856476e-97,9.02451411386314e-89,2.65562180398365e-80,2.87484306150778e-72,1.14490005416734e-64,1.67736095933739e-57,9.04046999069374e-51,1.79250766123562e-44,1.30748462778749e-38,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-1.62905597819496e-07
};

int testIndex = 0;


void setup() {
  // put your setup code here, to run once:
   Wire.begin();
    Serial.begin(9600);
    IMU.begin();
    Serial.println(" ");
    Serial.println("Started");
}

void loop() {
  // put your main code here, to run repeatedly:
 unsigned long startTime = millis();

    if (testIndex < TEST_DATA){

      float filteredECG = 10*testData[testIndex];
      //Serial.print("Test Data: ");
      //Serial.println(filteredECG);
      testIndex = testIndex + 1;

        // Apply Pan-Tompkins for QRS detection
        if (detectQRS(filteredECG)) {
            float heartRate = calculateHeartRate(millis());
            Serial.println(" ");
            Serial.print("Heart Rate: ");
            Serial.print(heartRate);
            Serial.println(" BPM");
        }
        unsigned long endTime = millis();
        unsigned long elapsedTime = endTime - startTime;

        if (elapsedTime < SAMPLINGPERIOD) { //account for the time that has elapsed during program execution when sampling
            delay(SAMPLINGPERIOD - elapsedTime);
        }

      Serial.print(filteredECG);
      Serial.print("     ");
    }    

}

bool detectQRS(float sample) {
    // Differentiate and square (simplified example)
    static float lastSample = 0;
    float derivative = sample - lastSample;
    lastSample = sample;
    float squared = derivative * derivative;

    // Moving window integration
    static int index = 0;
    integratedSignal[index] = squared;
    index = (index + 1) % windowSize;
    float sum = 0;
    for (int i = 0; i < windowSize; i++) {
        sum += integratedSignal[i];
    }
    float integrated = sum / windowSize;

    // Thresholding for QRS detection
    long currentTime = millis();
    if (integrated > threshold && currentTime - lastRPeakTime > REFRACTORY) { // 200 ms refractory period
        lastRPeakTime = currentTime;
        return true; // QRS detected
    }
    return false;
}

float calculateHeartRate(long rPeakTime) {
    static long lastRPeakTime = 0; //not reinitialized to 0 each time because static

    if (lastRPeakTime == 0) { //if this is the first R peak detected 
        lastRPeakTime = rPeakTime;
        return 0; 
    }
    
    float rrInterval = (rPeakTime - lastRPeakTime) / 1000.0; // Convert milliseconds to seconds
    lastRPeakTime = rPeakTime;
    return 60.0 / rrInterval; // BPM
}

